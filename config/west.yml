## config/west.yml
```yaml
manifest:
  remotes:
    - name: zmkfirmware
      url-base: https://github.com/zmkfirmware
    - name: ZitaoTech
      url-base: https://github.com/zanderp
  projects:
    - name: zmk
      remote: zanderp
      revision: bbkeyboard_tp
      import: app/west.yml
  self:
    path: config
```
